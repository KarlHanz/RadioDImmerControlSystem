void loop() {
  //  startCheckErr();   // самопроверка на ошибки при первом запуске (перезагрузке) и обработчик ошибок
  brightLvl(); //автоподстройка яркости дисплея
  tacho(); //тахометр
  displayPrint();

  //============== *НОРМИРОВАНИЕ ==============

  powerDev = map(dimmer, 0, 255, 0, 100); // маппинг единиц диммера 240-0 к шкале 0-100% без НОРМИРОВАНИЯ

  dim.write(dimmer);  // значение диммирования принимает 0-255

  // ===============МАССИВ ПЕРЕДАЧИ ТЕЛЕМЕТРИИ===============
  telemetry_data[0] = RPM;      //передаём точные обороты (0...2700) (которые потом сведутся к плавным фильтром среднего)
  telemetry_data[1] = powerDev; //возвращаем на дисплей значение мощности (0...100)
  telemetry_data[2] = relay;     //реле
  telemetry_data[3] = temp;     //температура
  telemetry_data[4] = statusCode;  //передаём цифровой код статуса


  // ================РАДИО ПРИЕМ-ПЕРЕДАЧА================

  while (radio.available()) {  // если есть связь с блоком управления:
    radio.read(&recieved_data, sizeof(recieved_data) ); // Принимаем массив
    dimmerExt = recieved_data[0]; // принимаем внешнее значение диммирования (0...255)
    radio.writeAckPayload(1, &telemetry_data, sizeof(telemetry_data)); //отправка ответного пакета телеметрии
    radioCommState = 1; //флаг наличия радиосвязи = 1 когда есть связь
    timeOut = millis();
  }

  if ((millis() - timeOut) > 5000) { // Сброс переменной timeOut при разрыве связи через пять сек её отсутствия
    radioCommState = 0;
  }

  // ================ ПРИ ПЕРВОМ ЗАПУСКЕ ПРОЦЕДУРА ПРОВЕРОК НА ОШИБКИ ================
  if (checkErrStart == 1 && ((millis() > 3000) && (millis() < 4000) && RPM <= 1000)) { //первое включение. ждём разгона до 1000 об за 4 сек.
    tachoFail = 1; // если не достигли нужных оборотов, ошибка тахо (либо не запустился мотор)
  } // ОШИБКА мотора или нет сигнала с тахометра (не подключен). [Выключить мотор: dimmer=240 и включить реле relay=1]

  if (checkErrStart == 1 && (millis() > 4000) && (millis() < 7000)) { //прошло более 4 сек после старта, включаю реле через 4 сек.
    dimmer = 255;  // на максимум
    relay = 1; // реле вкл, запуск через диммер
  } //флаг включения реле. Контакты размыкаются. Мотор разгоняется до максимума через диммер. Либо если контакты пригорели, мотор всё равно разгоняется

  if (checkErrStart == 1 && ((millis() > 7000) && (millis() < 9000) && RPM < 2000)) { //прошло более 7 сек после старта и обороты не достигли 2000
    dimmFail = 1;
  } // диммер плохо работает! [Включить мотор на полную через реле: dimmer=0, relay=0] Будет молотить бесконечно!

  if (checkErrStart == 1 && (millis() > 9000))  { ////Стартовые проверки завершены. Начинаем работать с принимаемым значением диммирования от блока управления либо работать сами по себе.
    checkErrStart = 0; //  Флаг старта обнуляем
  }

  if (checkErrStart == 1) statusCode = 10; //отправка статус кода 10 = "STARTING" на дисплей в течении старта




  // ================ УПРАВЛЕНИЕ ОБОРОТАМИ ================
  // При отсутствии ошибок и при отсутствии связи - управление оборотами по простой программе
  if (checkErrStart == 0 && statusCode < 100) { //управление после завершения старта и отсутствия ошибок

    if (radioCommState == 0) { // при отсутствии связи - управление оборотами по простой программе
      dimmer = dimmerInt;  // диммер на внутреннее управление
      statusCode = 0; //сброс кода статуса. //НЕ БУДЕТ ЛИ МЕШАТЬ?!

      if ((millis() - tmrStart) <= 600000) {
        relay = 0; //выключить (замкнуть) реле, включить мотор напрямую //на дисплее было бы LOAD
        dimmerInt = 255; // 10 мин на макс оборотах //диммер как резерв
      }
      if ((millis() - tmrStart) > 600000 && (millis() - tmrStart) <= 1200000) {
        relay = 1; //включить (разомкнуть) реле //на дисплее было бы DIMM
        dimmerInt = 105; // 10 мин на dimm=105 = 2400 оборотов
      }
      if ((millis() - tmrStart) > 1200000 && (millis() - tmrStart) <= 1800000) {
        relay = 1; //включить (разомкнуть) реле //на дисплее было бы DIMM
        dimmerInt = 50; // далее 10 мин работаем на dimm=40 = 1000 оборотов
      }
      if ((millis() - tmrStart) > 1800000) {
        relay = 1; //включить реле //на дисплее было бы DIMM
        dimmerInt = 0; //выключаем обороты после 30 мин работы
        statusCode = 90; //высветить dOnE на внутреннем дисплее
      }
    }

    if (radioCommState == 1) { //внешнее управление после завершения старта и наличия радиосвязи
      tmrStart = millis(); //обнулить таймер программы для запуска программы заново после пропадания радиосвязи
      relay = 1; //включить (разомкнуть) реле //на дисплее DIMM
      dimmer = dimmerExt; // диммер на внешнее управление
      statusCode = 20; //для индикации ONLINE. появится на на дисплее через пять сек после появления связи.
    }
  }



  // ================ ОБРАБОТЧИК ОШИБОК ================

  if (temp >= 60)  { //Постоянная проверка на превышение температуры. При значении 50 при жаре 30 срабатывает ошибка!
    tempFail = 1;
  } //   Перегрев! [dimmer=0, relay=0] Далее надо будет выключить реле, контакты замкнутся, диммер на отключение.
  if (temp < 60) {
    tempFail = 0;
  }

  if (tachoFail == 1) { // НЕТ ОБОРОТОВ. [Выключить мотор: dimmer=240 и включить реле relay=1]
    dimmer = 0; //выключить диммер
    relay = 1; //разомкнуть реле, отключить мотор от сети
    checkErrStart = 0; // старт завершен (с ошибками)
    statusCode = 110; // NO TACHO
  }

  if (dimmFail == 1) {  //НЕ РЕГУЛИРУЮТСЯ ОБОРОТЫ. [Включить мотор на полную через реле: dimmer=0, relay=0]
    dimmer = 0; //выключить диммер
    relay = 0; //отключить реле, подключив мотор к сети
    checkErrStart = 0; // старт завершен (с ошибками)
    statusCode = 120; // NO DIMM
  }

  if (relayFail == 1) {  //реле не размыкается - контакты пригорели. Ошибка не мешает эксплуатации. Выключить диммер: dimmer=240, relay=0]
    dimmer = 0; //выключить диммер
    relay = 0; //отключить реле, подключив мотор к сети
    checkErrStart = 0; // старт завершен (с ошибками)
    statusCode = 130; // NO RELAY
  }

  if (tempFail == 1) { //[Выключить мотор: dimmer=0 и relay=1]
    dimmer = 0; //выключить диммер
    relay = 1; //разомкнуть реле, отключить мотор от сети
    checkErrStart = 0; // старт завершен (с ошибками)
    statusCode = 140; // OVERHEAT
  }

  if (tempFail == 1 && (tachoFail == 1 || dimmFail == 1 || relayFail == 1)) { //отказ с перегревом!
    dimmer = 0; //выключить диммер
    relay = 1; //разомкнуть реле, отключить мотор от сети
    checkErrStart = 0; // старт завершен (с ошибками)
    statusCode = 150; // OVERHEAT&TROUBLE
  }

  //============== УПРАВЛЕНИЕ РЕЛЕ ==============

  digitalWrite(K1, relay); //
  brght = analogRead(Brg);
}
